## boards/shields/cradio-back/Kconfig.shield
```kconfig
config SHIELD_CRADIO_LEFT
    def_bool $(shields_list_contains,CRADIO_left)

config SHIELD_CRADIO_RIGHT
    def_bool $(shields_list_contains,CRADIO_right)
```

## boards/shields/cradio36/Kconfig.defconfig
```kconfig
if SHIELD_CRADIO36_LEFT

config ZMK_KEYBOARD_NAME
	default "HyperGolic"

endif


if SHIELD_CRADIO36_RIGHT

config ZMK_KEYBOARD_NAME
	default "HyperGolic-Right"

endif


config ZMK_KSCAN_DIRECT_POLLING
	default y
```

## boards/shields/cradios/Kconfig.defconfig
```kconfig
if SHIELD_CRADIOS_LEFT

config ZMK_KEYBOARD_NAME
	default "Hypergolic"

endif


if SHIELD_CRADIOS_RIGHT

config ZMK_KEYBOARD_NAME
	default "Hypergolic_Right"

endif


config ZMK_KSCAN_DIRECT_POLLING
	default n
```

## boards/shields/hillside48/Kconfig.defconfig
```kconfig
# Copyright (c) 2021 The ZMK Contributors
# SPDX-License-Identifier: MIT

if SHIELD_HILLSIDE48_LEFT
    config ZMK_KEYBOARD_NAME
        default "Hillside48"

    config ZMK_SPLIT_ROLE_CENTRAL
        default y

    config ZMK_SPLIT
        default y
endif

if SHIELD_HILLSIDE48_RIGHT
	config ZMK_SPLIT_ROLE_CENTRAL
		default n

    config ZMK_KEYBOARD_NAME
		default "HyperGarlic"

    config ZMK_SPLIT
        default y

endif
```

## boards/shields/hypergarlic/Kconfig.defconfig
```kconfig
config ZMK_SPLIT
    default y

if SHIELD_hypergarlic_LEFT
	config ZMK_SPLIT_ROLE_CENTRAL
		default y
	config ZMK_KEYBOARD_NAME
		default "HyperGarlic"

endif


if SHIELD_hypergarlic_RIGHT
	config ZMK_SPLIT_ROLE_CENTRAL
		default n
	config ZMK_KEYBOARD_NAME
		default "HyperGarlic"

endif

config ZMK_KSCAN_DIRECT_POLLING
	default n
```

## boards/shields/kaz/Kconfig.defconfig
```kconfig
# Copyright (c) 2024 The ZMK Contributors
# SPDX-License-Identifier: MIT





if SHIELD_kaz_LEFT
	config ZMK_SPLIT_ROLE_CENTRAL
		default y
	config ZMK_KEYBOARD_NAME
		default "Kaz"

endif

if SHIELD_kaz_LEFT || SHIELD_kaz_RIGHT

	config ZMK_SPLIT
		default y

	config ZMK_SPLIT_SERIAL
		default y

endif
```

## boards/shields/kaz/Kconfig.shield
```kconfig
# Copyright (c) 2024 The ZMK Contributors
# SPDX-License-Identifier: MIT

config SHIELD_kaz_LEFT
	def_bool $(shields_list_contains,kaz_left)

config SHIELD_kaz_RIGHT
	def_bool $(shields_list_contains,kaz_right)
```

## config/west.yml
```yaml
manifest:
  remotes:
    - name: zmkfirmware
      url-base: https://github.com/zmkfirmware
    - name: jlw # You can name this whatever you like; just make sure the "remote" below matches.
      url-base: https://github.com/josh-l-wang
  projects:
    - name: zmk
      remote: zmkfirmware
      revision: main
      import: app/west.yml
    - name: zmk-jlw-keyboards
      remote: jlw
      revision: main
  self:
    path: config
```
